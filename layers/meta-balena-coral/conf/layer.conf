## layers/meta-balena-coral/conf/layer.conf
```bitbake
BBPATH .= ":${LAYERDIR}"

BBFILES += "${LAYERDIR}/recipes-*/*/*.bb \
            ${LAYERDIR}/recipes-*/*/*.bbappend"

BBFILE_COLLECTIONS += "balena-coral"
BBFILE_PATTERN_balena-coral := "^${LAYERDIR}/"
BBFILE_PRIORITY_balena-coral = "1337"

SERIAL_CONSOLES:coral-dev = "115200;ttymxc0"

LAYERSERIES_COMPAT_balena-coral = "kirkstone"

LAYERDEPENDS_coral-bsp:remove = " clang-layer"
LAYERSERIES_COMPAT_coral-bsp:append = " kirkstone"

# we are still using our own older 4.14.98 linux-imx kernel recipe so let's delete what meta-coral is using
PREFERRED_PROVIDER_virtual/kernel:remove = "linux-coral"
PREFERRED_PROVIDER_virtual/kernel = "linux-imx"
PREFERRED_VERSION_linux-imx = "4.14.98"

KERNEL_IMAGETYPE:coral-dev = "Image.gz"

# meta-coral's linux-imx bbappend is for a different linux-imx kernel version
BBMASK .= " .*/layers/meta-coral/recipes-kernel/linux/linux-imx_%.bbappend"

KERNEL_DEVICETREE:coral-dev = " \
    freescale/fsl-imx8mq-phanbell.dtb \
    freescale/fsl-imx8mq-yorktown.dtb \
"
```

## layers/meta-balena-coral/conf/machine/asus-tinker-edge-t.conf
```bitbake
#@TYPE: Machine
##@NAME: asus-tinker-edge-t
##@DESCRIPTION: Machine configuration for ASUS Tinker Edge T

MACHINEOVERRIDES =. "coral-dev:"
include conf/machine/coral-dev.conf
```
